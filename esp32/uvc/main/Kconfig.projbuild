## esp32/uvc/main/Kconfig.projbuild
```kconfig
menu "Example Configuration"
    config EXAMPLE_ENABLE_STREAMING
        bool "Enable streaming"
        default n
        help
            Enables streaming of captured video.

    choice EXAMPLE_UVC_PROTOCOL_MODE
        prompt "UVC Protocol mode"
        default EXAMPLE_UVC_PROTOCOL_MODE_AUTO

        config EXAMPLE_UVC_PROTOCOL_MODE_AUTO
            bool "Auto"
            help
                When protocol mode set to Auto, the example tries to make three attempts to negotiate
                the protocol with following parameters:
                1 Attempt: 640x480, 15 FPS, MJPEG
                2 Attempt: 320x240, 30 FPS, MJPEG
                3 Attempt: 320x240, first available FPS, MJPEG
                If all three attempts result in an error, the example displays the error message and
                suggests to try another USB UVC Device.

        config EXAMPLE_UVC_PROTOCOL_MODE_CUSTOM
            bool "Custom"
            help
                When protocol mode set to Custom, the example tries to negotiate protocol with
                configured parameters: Attempts, Width, Height, FPS, Frame Coding format.
                After all attempts result in an error, the example displays the error message and
                suggests to try another USB UVC Device.

    endchoice

    config EXAMPLE_NEGOTIATION_ATTEMPTS
        int "Negotiation attempts"
        default 3
        help
            Number of attempts to negotiate custom protocol parameters.

    menu "UVC Protocol parameters"
        depends on EXAMPLE_UVC_PROTOCOL_MODE_CUSTOM

        config EXAMPLE_WIDTH_PARAM
            int "Width resolution in pixels"
            default 320
            help
                Configure the negotiation width parameter during UVC device stream getting.
        config EXAMPLE_HEIGHT_PARAM
            int "Height resolution in pixels"
            default 240
            help
                Configure the negotiation height parameter during UVC device stream getting.
        config EXAMPLE_FPS_PARAM
            int "FPS"
            default 30
            help
                Configure the negotiation FPS parameter during UVC device stream getting.
                Can be any value, available from the Frame Descriptor of the UVC device.
                When 0 - negotiation accept the first rate available.

        choice EXAMPLE_NEGOTIATION_FORMAT
            prompt "Frame coding format of the stream, transport-independent"
            default UVC_FRAME_FORMAT_MJPEG
            help
                Configure the negotiation frame coding of stream.

            config UVC_FRAME_FORMAT_UNKNOWN
                bool "Unknown"
            config UVC_FRAME_FORMAT_UNCOMPRESSED
                bool "Uncompressed"
            config UVC_FRAME_FORMAT_COMPRESSED
                bool "Compressed"
            config UVC_FRAME_FORMAT_YUYV
                bool "YUYV"
            config UVC_FRAME_FORMAT_UYVY
                bool "UYVY"
            config UVC_FRAME_FORMAT_RGB
                bool "RGB"
            config UVC_FRAME_FORMAT_BGR
                bool "BGR"
            config UVC_FRAME_FORMAT_MJPEG
                bool "MJPEG"
            config UVC_FRAME_FORMAT_GRAY8
                bool "GRAY8"
            config UVC_FRAME_FORMAT_GRAY16
                bool "GRAY16"
            config UVC_FRAME_FORMAT_NV12
                bool "NV12"

        endchoice

        config EXAMPLE_FORMAT_PARAM
            int
            default 0  if UVC_FRAME_FORMAT_UNKNOWN
            default 1  if UVC_FRAME_FORMAT_UNCOMPRESSED
            default 2  if UVC_FRAME_FORMAT_COMPRESSED
            default 3  if UVC_FRAME_FORMAT_YUYV
            default 4  if UVC_FRAME_FORMAT_UYVY
            default 5  if UVC_FRAME_FORMAT_RGB
            default 6  if UVC_FRAME_FORMAT_BGR
            default 7  if UVC_FRAME_FORMAT_MJPEG
            default 9  if UVC_FRAME_FORMAT_GRAY8
            default 10 if UVC_FRAME_FORMAT_GRAY16
            default 17 if UVC_FRAME_FORMAT_NV12
    endmenu

    choice EXAMPLE_IP_MODE
        prompt "IP Version"
        depends on EXAMPLE_SOCKET_IP_INPUT_STRING
        help
            Example can use either IPV4 or IPV6.

        config EXAMPLE_IPV4
            bool "IPV4"

        config EXAMPLE_IPV6
            bool "IPV6"

    endchoice

    config EXAMPLE_IPV4_ADDR
        string "IPV4 Address"
        default "192.168.0.165"
        depends on EXAMPLE_IPV4
        help
            The example will connect to this IPV4 address.

    config EXAMPLE_IPV6_ADDR
        string "IPV6 Address"
        default "FE80::30AD:E57B:C212:68AD"
        depends on EXAMPLE_IPV6
        help
            The example will connect to this IPV6 address.

    config EXAMPLE_PORT
        int "Port"
        range 0 65535
        default 3333
        help
            The remote port to which the client example will connect to.

    choice EXAMPLE_INTERFACE
        prompt "Interface selection"
        depends on EXAMPLE_IPV6
        help
            Example can use either "Auto" or "User specified".

        config EXAMPLE_IFACE_AUTO
            bool "Auto"

        config EXAMPLE_USER_SPECIFIED_IFACE
            bool "User specified interface"
    endchoice

    config EXAMPLE_USER_SPECIFIED_IFACE_NAME
        string "User specified interface name"
        default "st1"
        depends on EXAMPLE_USER_SPECIFIED_IFACE
        help
            This interface will be used for communication.

    choice EXAMPLE_SOCKET_IP_INPUT
        prompt "Socket example source"
        default EXAMPLE_SOCKET_IP_INPUT_STRING
        help
            Selects the input source of the IP used in the example.

        config EXAMPLE_SOCKET_IP_INPUT_STRING
            bool "From string"

        config EXAMPLE_SOCKET_IP_INPUT_STDIN
            bool "From stdin"
    endchoice

endmenu
```
